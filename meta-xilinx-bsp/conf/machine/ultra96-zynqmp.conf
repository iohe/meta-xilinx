## meta-xilinx-bsp/conf/machine/ultra96-zynqmp.conf
```bitbake
#@TYPE: Machine
#@NAME: ultra96-zynqmp
#@DESCRIPTION: Machine support for Ultra96 Evaluation Board.
#

SOC_VARIANT ?= "eg"

require conf/machine/include/tune-zynqmp.inc
require conf/machine/include/machine-xilinx-overrides.inc
require conf/machine/include/machine-xilinx-default.inc
require conf/machine/include/machine-xilinx-qemu.inc

MACHINE_FEATURES = "rtc ext2 ext3 vfat usbhost usbgadget wifi bluetooth"

UBOOT_MACHINE = "xilinx_zynqmp_zcu100_revC_defconfig"
SPL_BINARY ?= "spl/boot.bin"

SERIAL_CONSOLE = "115200 ttyPS0"

SERIAL_CONSOLES_CHECK = "${SERIAL_CONSOLES}"

KERNEL_DEVICETREE = "xilinx/zynqmp-zcu100-revC.dtb"

PREFERRED_PROVIDER_virtual/kernel ?= "linux-xlnx"
PREFERRED_PROVIDER_virtual/bootloader ?= "u-boot-xlnx"

EXTRA_IMAGEDEPENDS += " \
		u-boot-zynq-uenv \
		arm-trusted-firmware \
		virtual/boot-bin \
		"

IMAGE_BOOT_FILES += " \
               uEnv.txt \
               atf-uboot.ub \
               "
```

## meta-xilinx-standalone/conf/distro/xilinx-standalone.conf
```bitbake
DISTRO = "xilinx-standalone"
DISTRO_NAME = "Xilinx Standalone Distro"
DISTRO_VERSION = "1.0"
TARGET_VENDOR = "-xilinx"

TCLIBC = "newlib"
TCLIBCAPPEND =""

# Change SDK name
SDK_VERSION = "xilinx-standalone"

BB_DANGLINGAPPENDS_WARNONLY = "1"
```
